## devices/ficgta01/oe/local/packages/conf/local.conf
```bitbake
MACHINE = "fic-gta01"
DISTRO = "openmoko"
BUILD_ARCH = "i686"
ENABLE_BINARY_LOCALE_GENERATION = "0"
ASSUME_PROVIDED += "qemu-native"
BBFILES := "${OMDIR}/openembedded/packages/*/*.bb ${OMDIR}/local/packages/*/*.bb"
BBFILE_COLLECTIONS = "upstream local overlay"
BBFILE_PATTERN_overlay = "^${OMDIR}/local/"
BBFILE_PRIORITY_overlay = "20"
export BBPATH="${OMDIR}/build:${OMDIR}/local:${OMDIR}/oe:${OMDIR}/openembedded"
TERMCMD = KONSOLE_TERMCMD
TERMCMDRUN = KONSOLE_TERMCMDRUN
CROSS_DIR = "/opt/toolchains/arm920t-eabi"
```
